## drivers/input/touchscreen/mediatek/Kconfig
```kconfig
#
# Touchscreen driver configuration
#
menuconfig INPUT_TOUCHSCREEN
	bool "Touchscreens"
	help
	  Say Y here, and a list of supported touchscreens will be displayed.
	  This option doesn't affect the kernel.

	  If unsure, say Y.

if INPUT_TOUCHSCREEN

config TOUCHSCREEN_MTK
	bool "MediaTek Touch Panel Driver"
	help
	Say Y here if you have MediaTek touch panel.

	If unsure, say N.

	To compile this dirver as a module, choose M here: the
	module will be called.

config TOUCHSCREEN_MTK_GT1151
	bool "GT1151 for Mediatek package"
	default n
	help
	Say Y here if you have GT1151 touch panel.

	If unsure, say N.

	To compile this dirver as a module, choose M here: the
	module will be called.

source "drivers/input/touchscreen/mediatek/GT1151/Kconfig"

config TOUCHSCREEN_MTK_GT928
	tristate "GT928 Touchscreen"
	help
	  Say Y here if you have Goodix GT928 touchscreen,
	  connected to your system.
	  If unsure, say N.
	  To compile this driver as a module, choose M here.

config TOUCHSCREEN_MTK_SYNAPTICS_I2C_RMI4
	tristate "Synaptics DSX I2C touchscreen"
	depends on I2C
	help
	  Say Y here if you have a Synaptics DSX I2C touchscreen
	  connected to your system.

	  If unsure, say N.

	  To compile this driver as a module, choose M here: the
	  module will be called synaptics_i2c_rmi4.

source "drivers/input/touchscreen/mediatek/synaptics_i2c_rmi4/Kconfig"

config TOUCHSCREEN_MTK_GT910
	bool "GT910 for Mediatek package"
	default n
	help
	Say Y here if you have GT910 touch panel.

	If unsure, say N.

	To compile this dirver as a module, choose M here: the
	module will be called.

source "drivers/input/touchscreen/mediatek/GT910/Kconfig"

config TOUCHSCREEN_MTK_FT5X0X
	bool "FT5X0X for Mediatek package"
	default n
	help
	  Say Y here if you have FT5X0X touch panel.

	  If unsure, say N.

	  To compile this dirver as a module, choose M here: the
	  module will be called.

source "drivers/input/touchscreen/mediatek/ft5x0x/Kconfig"

config TOUCHSCREEN_MTK_GT5668
	bool "GT5668 for Mediatek package"
	default n
	help
	Say Y here if you have GT5668 touch panel.

	If unsure, say N.

config TOUCHSCREEN_SET_INTERRUPT_TO_INPUT
	bool "Set Interrupt pin to input manually"
	depends on abe123
	default n
	help
	Set to ensure interrupt pin on touch panel is set
	to input mode using gpio subsystem.

source "drivers/input/touchscreen/mediatek/GT5668/Kconfig"

endif
```

## drivers/misc/mediatek/gpu/Kconfig
```kconfig
#
# Copyright (C) 2016 MediaTek Inc.
#
# This program is free software; you can redistribute it and/or modify
# it under the terms of the GNU General Public License version 2 as
# published by the Free Software Foundation.
#
# This program is distributed in the hope that it will be useful,
# but WITHOUT ANY WARRANTY; without even the implied warranty of
# MERCHANTABILITY or FITNESS FOR A PARTICULAR PURPOSE.
# See http://www.gnu.org/licenses/gpl-2.0.html for more details.
#


config MTK_GPU_SUPPORT
	bool CONFIG_MTK_GPU_SUPPORT
	default n
	help
	  CONFIG_MTK_GPU_SUPPORT define if the gpu driver should be built in or not
```

## drivers/misc/mediatek/lcm/Kconfig
```kconfig
config MTK_LCM
	bool CONFIG_MTK_LCM
	default n
	help
	  LCM driver

config CUSTOM_KERNEL_LCM
	string "CUSTOM_KERNEL_LCM"
	help
	  To choose kernel LCM driver name

config PANEL_BRIGHTNESS_SCALING
    bool CONFIG_PANEL_BRIGHTNESS_SCALING
    default n
    help
      Enables brightness scaling on a per panel basis.

config PANEL_BRIGHTNESS_SCALING_DEBUG
    depends on PANEL_BRIGHTNESS_SCALING
    bool CONFIG_PANEL_BRIGHTNESS_SCALING_DEBUG
    default n
    help
      Adds device files to debug brightness scaling
```

## drivers/staging/amazon/Kconfig
```kconfig
menu "Amazon"

config AMAZON
	bool "Amazon Drivers"
	default N
	---help---
	  Enable support for various drivers needed on the Amazon Fire OS platform

if AMAZON

config AMAZON_KLOG_CONSOLE
	bool "Amazon Kernel Log Console"
	depends on ANDROID_LOGGER
	default N
	---help---
	  provide the kernel log console which will rewrite the kernel message to Android Logger buffer.

config AMAZON_KLOG_CONSOLE_TRYLOCK
	bool "Amazon Kernel Log Console"
	depends on AMAZON_KLOG_CONSOLE
	default n
	---help---
	  try to get the mutex before we write outthe current payload.

config AMAZON_LOGD
    bool "Amazon Logd"
    depends on ANDROID_LOGGER
    default N
    ---help---
      device uses logd for logging

config AMAZON_SIGN_OF_LIFE
	bool "Amazon Sign of Life"
	help
	enable the life cycle metrics to log device boot and shutdown information

config AMAZON_SIGN_OF_LIFE_MTK
	bool "Amazon Sign of Life MTK platform implementation"
	help
	enable the life cycle metrics to log device boot and shutdown information on MTK Platform

config AMAZON_SIGN_OF_LIFE
	bool "Amazon Sign of Life"
	help
	enable the life cycle metrics to log device boot and shutdown information

config AMAZON_SIGN_OF_LIFE_MTK
	bool "Amazon Sign of Life MTK platform implementation"
	help
	enable the life cycle metrics to log device boot and shutdown information on MTK Platform

config AMAZON_POWEROFF_LOG
	bool "Long press key power off log"
	default N
	help
	enable Long press key power off log

config abh123
	bool "abh123 MTK platform project"
	help
	isolate amazon abh123 changes for MTK Platform

config rbc123
	bool "rbc123 MTK platform project"
	help
	isolate amazon rbc123 changes for MTK Platform

config abc123
	bool "abc123 MTK platform project"
	help
	isolate Amazon abc123 changes for MTK Platform

config AMAZON_LL_LOG
        bool "Low Level Log Support"
        depends on PROC_FS
        default n
        help
          Cache the log of LK and Preloader at /proc/pllk.

config AMAZON_A2DP_TS
	bool "Gather and report A2DP timestamps"
	depends on MTK_BTIF
	help
	Enable A2DP timestamps reporting to user space

choice
	prompt "A2DP timestamps"
	depends on AMAZON_A2DP_TS
	default AMAZON_A2DP_TS_DMA

config AMAZON_A2DP_TS_DMA
	bool "A2DP timestamps are gathered when we trigger DMA transfer"

endchoice

endif # if AMAZON

endmenu
```
